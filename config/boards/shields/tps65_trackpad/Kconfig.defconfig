## config/boards/shields/tps65_trackpad/Kconfig.defconfig
```kconfig
if SHIELD_TPS65_TRACKPAD

config ZMK_KEYBOARD_NAME
    default "TPS65 Trackpad"


config I2C
	default y
      
config ZMK_POINTING
	default y

endif
```

## zmk-config/boards/shields/tps65_trackpad/Kconfig.defconfig
```kconfig
if SHIELD_TPS65_TRACKPAD

config I2C
	default y
      
config ZMK_POINTING
	default y

endif
```

## zmk-config/boards/shields/tps65_trackpad/Kconfig.shield
```kconfig
config SHIELD_TPS65_TRACKPAD
    def_bool $(shields_list_contains,tps65_trackpad)
```
